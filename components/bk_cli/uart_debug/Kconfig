## components/bk_cli/uart_debug/Kconfig
```kconfig
menu "modules::uart_debug"
	config UART_DEBUG
		depends on UART_ATE_PORT
		bool "Enable Uart Debug"
		default n

	config ATE
		bool "Enable ATE"
		default y

	config ATE_TEST
		depends on ATE
		bool "Enable ATE Test"
		default n

	config ATE_LV_WAKEUP_USE_RTC
		depends on ATE
		bool "ATE low voltage wakeup via RTC"
		default n

	config ATE_PHY_PWR_TBL_VERSION
		depends on ATE
		int "Select PHY_PWR_TBL version"
		default "0"

	config ATE_PHY_PWR_ANA_VERSION
		depends on ATE
		int "Select PHY_PWR_ANA version"
		default "0"

	config MEMCHECK_ADAPTER_FOR_QFN40
		depends on ATE
		bool "Enable MEMCHECK Adapter to QFN40"
		default n
endmenu
```

## components/bk_mac802154/Kconfig
```kconfig
menu "mac802154"
	config MAC802154_ENABLE
		bool "Enable IEEE802.15.4"
		default n

    config MAC802154_RX_SFD_EN
        bool "Enable rx sfd interrupt"
        default n
    config MAC802154_TX_SFD_EN
        bool "Enable tx sfd interrupt"
        default n
endmenu
```

## components/bk_ota/Kconfig
```kconfig
menu "OTA"
	config BK_OTA
		bool "Enable new OTA"
		default n
		help
			enable new OTA

	config OTA_STATUS_CONFIRM
		bool "OTA status confirm by application only (bk_init never touches)"
		depends on BK_OTA
		default n
		help
			When enabled, bk_init() will NEVER call OTA status confirm APIs:
			bk_ota_cancel_update(), bk_ota_accept_image(), or
			bk_ota_update_pubkey_partition(). Application must invoke them.
			When disabled (default), bk_init performs OTA status confirm on boot.

	#TODO fix me, delete this config after OTA refactor completed
	config BK_OTA_NEW_PACK_TOOL
		bool "Enable new pack tool"
		default n
		help
			enable new pack tool

	config OTA_MAGIC_BYTES
		string "Set flash magic bytes"
		default "BEKEN"

	config OTA_BACKUP_PUBKEY_ENCRYPT
		bool "Enable backup pubkey encrypt"
		default n

	config OTA_VERIFY_PUBKEY
		bool "Verify OTA public key during image validation"
		depends on BK_OTA
		default y

	config OTP_BL2_PUBKEY_HASH
		bool "Verify OTA public key against OTP BL2 pubkey hash"
		depends on BK_OTA && PSA_MBEDTLS && !OTA_VERIFY_PUBKEY
		default n

endmenu
```

## components/bk_phy/Kconfig
```kconfig
#TODO optimize it
menu "Bk_Phy"

	config PHY_LOG_ENABLE
		bool "Enable voltage detect"
		default n

	config DPD_CALI
		bool "Enable DPD Cali"
		default n

	config FT_TXPWR_CAL
		bool "Enable FT TX power calibration from OTP"
		default y
		help
			Read FT power calibration from OTP_PHY_PWR1/OTP_PHY_PWR2.

	config DPD_CALI_GROUP
		int "Number of Group for DPD Cali"
		default 8

	config RF_COEX_JUDGE
		bool "Enable rf coex judge with wifi ble thread temp"
		default n

endmenu
```

## components/bk_system/Kconfig
```kconfig
#TODO may need to remove this component!
menu "BK_system"

	menu "Mac Config"
		choice BASE_MAC_SRC
			prompt "Select Base Mac Source"
			default NEW_MAC_POLICY

			config BASE_MAC_FROM_EFUSE
				bool "BASE_MAC_FROM_EFUSE"
			config BASE_MAC_FROM_RF_OTP_FLASH
				bool "BASE_MAC_FROM_RF_OTP_FLASH"
			config NEW_MAC_POLICY
				bool "NEW_MAC_POLICY"
			config BASE_MAC_FROM_OTP1
				bool "BASE_MAC_FROM_OTP1"
		endchoice

		config RANDOM_MAC_ADDR
	        bool "Enable Random Mac Addr"
	        default n

		config BK_MAC_ADDR_CHECK
			bool "Enable Beken Mac Addr Check"
			default n

		config CUS_MAC_MASK
			hex "Set Customize Mac Address Mask"
			default 0
	endmenu

    menu "Product ID Config"
        choice SPID_OFFSET_IN_BOOT_CHOICE
            prompt "SPID offset in boot"
            default SPID_OFFSET_IN_BOOT_0X8

            config SPID_OFFSET_IN_BOOT_0X8
                bool "0x8"

            config SPID_OFFSET_IN_BOOT_0XA
                bool "0xA"
        endchoice

        config SPID_OFFSET_IN_BOOT
            hex
            default 0x8 if SPID_OFFSET_IN_BOOT_0X8
            default 0xA if SPID_OFFSET_IN_BOOT_0XA
            help
                Offset of product ID field relative to boot base address.
                Final write address is:
                - CRC mode:    0x110 + CONFIG_SPID_OFFSET_IN_BOOT
                - NO_CRC mode: 0x100 + CONFIG_SPID_OFFSET_IN_BOOT
                Only 0x8 and 0xA are supported.
    endmenu

	menu "Print Config"
		choice SYSTEM_PRINT_DEVICE
			prompt "System print device"
			default SYS_PRINT_DEV_UART

			config SYS_PRINT_DEV_UART
				bool "System print by uart"

			config SYS_PRINT_DEV_MAILBOX
				bool "System print by mailbox"

			config SYS_PRINT_DEV_NULL
				bool "Close system print"
		endchoice

		choice SYSTEM_LOG_LEVEL
			prompt "System log level"
			default SYS_LOG_INFO
			config SYS_LOG_NONE
				bool "No output"
			config SYS_LOG_ERROR
				bool "Error"
			config SYS_LOG_WARN
				bool "Warning"
			config SYS_LOG_INFO
				bool "Info"
			config SYS_LOG_DEBUG
				bool "Debug"
			config SYS_LOG_VERBOSE
				bool "Verbose"
		endchoice

		config SUPPORT_LOG_LEVEL_CFG
			bool "support config log level"
			default n

		config FWD_CMD_TO_CPUx
			depends on MAILBOX
			bool "Forward cpu1/cpu2 cmd by mailbox"
			default y

		config SMP_SYNC_PRINTF
			bool "smp sync printf"
			default n

		config UART_PRINT_BAUD_RATE
			depends on SYS_PRINT_DEV_UART
			int "uart print baud rate"
			default "115200"
	endmenu
endmenu
```

## components/easy_flash/Kconfig
```kconfig
menu "Easy_flash"
	config EASY_FLASH
		depends on FLASH
		bool "Enable Easy Flash"
		default y

	config EASY_FLASH_TEST
		depends on EASY_FLASH
		bool "Enable Easy Flash Test"
		default n

	config EASY_FLASH_ENV_BACKUP_ENABLE
		depends on EASY_FLASH
		bool "Enable Easy Flash ENV backup partition"
		default n

	menu "Modify Easy Flash Config"
		depends on EASY_FLASH

		choice EASY_FLASH_VER
			prompt "Select Easy Flash Version"
			default EASY_FLASH_V4

			config EASY_FLASH_V4
				bool "EASY_FLASH_V4"
				help
					EASY_FLASH v4.1.0
		endchoice
	endmenu
endmenu
```

## components/https_ota/Kconfig
```kconfig
menu "Https_ota"
	config OTA_TEST
		bool "Enable ota test"
		default n

	config OTA_UPDATE_PUBKEY
		bool "use public key in flash"
		default n

	config OTA_BACKUP_PUBKEY
		bool "backup public key in flash partition"
		default n

	config VALIDATE_DURING_DOWNLOADING
		bool "mcuboot validate before reboot"
		default n
	
	config VALIDATE_IMAGE
		bool "global signature verification switch"
		default y
	
	config VALIDATE_IMAGE_HASH_ONLY
		bool "Validate image hash only (skip pubkey and signature TLV)"
		default n
		help
			When enabled, BL2 and application OTA stop after SHA TLV matches
			the computed digest; pubkey and signature TLVs are not verified.
endmenu
```

## middleware/driver/deep_lv/Kconfig
```kconfig
menu "DEEP_LV"
	config DEEP_LV
		bool "Enable deep low voltage"
		default n

	config DEEP_LV_FAST_BOOT
		bool "Enable deep lv fast boot"
		depends on DEEP_LV
		default n
endmenu
```

## middleware/driver/efuse/Kconfig
```kconfig
menu "EFUSE"
	config EFUSE
		bool "Enable efuse"
		default y

	config EFUSE_ALLOW_WRITE
		bool "Allow efuse hardware write"
		default n
endmenu
```

## middleware/driver/flash/Kconfig
```kconfig
menu "FLASH"
	config FLASH
		bool "Enable flash"
		default y

	config FLASH_QUAD_ENABLE
		bool "Enable flash quad enable"
		default n

	config FLASH_PAGE_WRITE_ENABLE
		depends on FLASH
		bool "Enable flash page write function"
		default n

	config FLASH_WRITE_SOFT_ERASE_OPTIM_ENABLE
		depends on FLASH
		bool "Enable flash write soft erase optimization"
		default n

	config FLASH_BYPASS_PAGE_ERASE
		depends on FLASH
		bool "Flash bypass page erase"
		default n

	config FLASH_BYPASS_READ_UID
		depends on FLASH
		bool "Flash bypass read UID"
		default n

	config FLASH_SRC_CLK_60M
		bool "Enable flash source clock 60M"
		default n

	config FLASH_ORIGIN_API
		bool "Enable flash old api"
		default n

	config FLASH_V1P1
		bool "Enable flash v1.1 implementation"
		default n
		help
			Enable customer flash v1.1 style implementation.
			When disabled, use the legacy flash implementation.

	config SUPPORT_PARTITIONS_PARTITION
		bool "Enable flash partition"
		default n

	config PARTITION_ENCRYPTION
		bool "Enable flash partition encryption"
		default n
		help
		  Enable MBEDTLS-AES-XTS encryption/decryption for selected partitions.

	config FLASH_MB
		bool "Enable flash mailbox channel"
		depends on MAILBOX
		depends on !SOC_SMP
		default n

	config FLASH_TEST
		depends on FLASH
		bool "Enable flash test"
		default y

	config FLASH_UT_TEST
		depends on FLASH_TEST
		bool "Enable flash driver unit test"
		default y
		help
		  Enable flash_ut_test.c preset unit tests (flash_driver_test).

	config FLASH_RACE_TEST
		depends on FLASH_TEST
		bool "Enable flash race test"
		default n

	config FLASH_PSRAM_PRESSURE_TEST
		depends on FLASH && DRIVER_TEST
		bool "Enable flash test"
		default n

	config FLASH_PRESSURE_TEST
		depends on FLASH && DRIVER_TEST
		bool "Enable flash test"
		default n

	config PARTITION_TEST
		depends on FLASH
		bool "Enable pattition test"
		default y

	config FLASH_API_TEST
		depends on FLASH
		bool "Enable flash_api test"
		default n

	config FLASH_SVR_TEST
		depends on FLASH_TEST
		bool "Enable flash server test (multi-core flash mutex test)"
		default n
		help
		  Enable flash_svr_test.c for multi-core flash access test.
		  Only takes effect when CONFIG_CPU_CNT > 1. Single-core builds
		  never compile this file.

	config FLASH_WRITE_STATUS_VOLATILE
		bool "Enable write volatile status register"
		default y

	config FLASH_PARTITION_CHECK_VALID
		depends on FLASH
		bool "Enable flash driver check write permission and address range"
		default n

	config FLASH_CLK_120M
		depends on FLASH
		bool "Enable flash clk using 120M"
		default n

	config FLASH_BYPASS_OTP_OPERATION
		depends on FLASH
		bool "Bypass flash to operate otp in flash"
		default n

	config EXT_FLASH_CLK_FREQ
		depends on FLASH
		int "Select flash clk frequency"
		default "40000000"

	config FLASH_CLK_FREQ
		depends on FLASH
		int "Select flash clk frequency"
		default "80000000"

	config FLASH_CBUS
		depends on FLASH
		bool "Enable flash cbus API"
		default n

	config FLASH_BYPASS_OTP_V2
		depends on FLASH
		depends on !FLASH_BYPASS_OTP_OPERATION
		bool "Flash bypass OTP (V2)"
		default n
		help
			OTP bypass via flash_bypass_op_read/write in ITCM or IRAM.

endmenu
```

## middleware/driver/mailbox/Kconfig
```kconfig
menu "MAILBOX"
	config MAILBOX
		bool "Enable mail_box"
		default n

	config MAILBOX_V2_0
		bool "Use mailbox v2.0 driver"
		default n

	config MAILBOX_IPC
		bool "Enable mailbox socket ipc driver"
		default y
endmenu
```

## middleware/driver/wdt/Kconfig
```kconfig
menu "Watchdog"
	config INT_WDT
		bool "Enable Interrupt Watchdog"
		default y

	config INT_WDT_PERIOD_MS
		int "Interrupt Watchdog Period(ms)"
		default 1000

	config TASK_WDT
		bool "Enable Task Watchdog"
		default y

	config TASK_WDT_PERIOD_MS
		int "Task Watchdog Period(ms)"
		default 60000

	config NMI_WDT_EN
		bool "Enable NMI Watchdog"
		default n

	config WDT_TEST
		depends on INT_WDT && DRIVER_TEST
		bool "Enable watchdog test"
		default n

	config WDT_API_TEST
		depends on INT_WDT && DRIVER_TEST
		bool "Enable watchdog api test"
		default n
endmenu
```
