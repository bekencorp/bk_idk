## components/psa_mbedtls/Kconfig
```kconfig
menu "PSA Mbedtls"
	config PSA_MBEDTLS
		bool "Enable mbedtls v3.5.2"
		default n

	menu "PSA Mbedtls Options"
		depends on PSA_MBEDTLS

		config PSA_MBEDTLS_TEST
			bool "Enable psa mbedtls test"
			default n
	
		config PSA_CUSTOMIZATION_TZ_L
			bool "Enable adapt customization interface"
			default n
	
		config PSA_CUSTOMIZATION_TEST
			bool "Enable psa customization test"
			default n
	
		config MBEDTLS_SSL_IN_CONTENT_LEN
			int "Config MBEDTLS_SSL_IN_CONTENT_LEN"
			default 4096
	
		config MBEDTLS_SSL_OUT_CONTENT_LEN
			int "Config MBEDTLS_SSL_OUT_CONTENT_LEN"
			default 4096
	
		config TE200_ENTROPY
			bool "Enable TE200 entropy"
			default n
	
		config TRUSTENGINE_TEST
			bool "Enable security engine cli"
			depends on !DEEP_LV && !BAKP_POWER_DOMAIN_DISABLE
			default n

		config TRUSTENGINE
			bool "Enable hardware crypto engine"
			depends on !DEEP_LV && !BAKP_POWER_DOMAIN_DISABLE
			default n

		config TRUSTENGINE_PM_CB_SUPPORT
			bool "Enable trustengine pm cb support"
			depends on !DEEP_LV && !BAKP_POWER_DOMAIN_DISABLE
			default y

		config SW_CRYPTO
			bool "Enable software crypto"
			default n

		config MBEDTLS_USE_PSA_CRYPTO
			bool "Enable use PSA crypto"
			default n

		config FULL_MBEDTLS
			bool "Enable Full Mbedtls"
			default n

		config MBEDTLS_LOG_LEVEL
			string "Set Mbedtls Log Level"
			default "INFO"
			help
				Set mbedtls log level: OFF/ERROR/WARNING/INFO/DEBUG
	endmenu

endmenu

menu "Certificate Bundle"

	config MBEDTLS_CERTIFICATE_BUNDLE
		bool "Enable trusted root certificate bundle"
		default n
		help
			Enable support for large number of default root certificates

			When enabled this option allows user to store default as well
			as customer specific root certificates in compressed format rather
			than storing full certificate. For the root certificates the public key and the subject name
			will be stored.

	choice MBEDTLS_DEFAULT_CERTIFICATE_BUNDLE
		bool "Default certificate bundle options"
		depends on MBEDTLS_CERTIFICATE_BUNDLE
		default MBEDTLS_CERTIFICATE_BUNDLE_DEFAULT_FULL

		config MBEDTLS_CERTIFICATE_BUNDLE_DEFAULT_FULL
			bool "Use the full default certificate bundle"
		config MBEDTLS_CERTIFICATE_BUNDLE_DEFAULT_CMN
			bool "Use only the most common certificates from the default bundles"
			help
				Use only the most common certificates from the default bundles, reducing the size with 50%,
				while still having around 99% coverage.
		config MBEDTLS_CERTIFICATE_BUNDLE_DEFAULT_NONE
			bool "Do not use the default certificate bundle"
	endchoice

	config MBEDTLS_CUSTOM_CERTIFICATE_BUNDLE
		depends on MBEDTLS_CERTIFICATE_BUNDLE
		default n
		bool "Add custom certificates to the default bundle"
	config MBEDTLS_CUSTOM_CERTIFICATE_BUNDLE_PATH
		depends on MBEDTLS_CUSTOM_CERTIFICATE_BUNDLE
		string "Custom certificate bundle path"
		help
			Name of the custom certificate directory or file. This path is evaluated
			relative to the project root directory.

	config MBEDTLS_CERTIFICATE_BUNDLE_DEPRECATED_LIST
		bool "Add deprecated root certificates"
		depends on MBEDTLS_CERTIFICATE_BUNDLE && !MBEDTLS_CERTIFICATE_BUNDLE_DEFAULT_NONE
		help
			Include the deprecated list of root certificates in the bundle.
			This list gets updated when a certificate is removed from the Mozilla's
			NSS root certificate store. This config can be enabled if you would like
			to ensure that none of the certificates that were deployed in the product
			are affected because of the update to bundle. In turn, enabling this
			config keeps expired, retracted certificates in the bundle and it may
			pose a security risk.

			- Deprecated cert list may grow based based on sync with upstream bundle
			- Deprecated certs would be be removed in ESP-IDF (next) major release

	config MBEDTLS_CERTIFICATE_BUNDLE_MAX_CERTS
		int "Maximum no of certificates allowed in certificate bundle"
		default 200
		depends on MBEDTLS_CERTIFICATE_BUNDLE

endmenu
```

## components/wpa_supplicant-2.10/Kconfig
```kconfig
menu "modules::wpa_supplicant-2.10"

	config WPA_SUPPLICANT
		depends on WIFI_ENABLE
		bool "Enable Wpa Supplicant 2.10"
		default y
		help
			Enable wpa_supplicant-2.10

	menu "Modify Wpa Supplicant 2.10 Config"
		depends on WPA_SUPPLICANT

		config TASK_WPAS_PRIO
			int "Set Task Wpas Prio"
			range 1 10
			default 5
			help
				Priority of WPAS task

		config WPA3
			bool "Enable WPA3"
			default y
			help
				When WPA3 is enabled, the PMF should be enabled also!

		config SOFTAP_WPA3
			bool "Enable Softap WPA3"
			default n
			help
				Enable softap WPA3 SAE. This may costs some code size. Use mbedtls as
				the crypto suite may accelerate ECC caculation speed.

		config PMF
			bool "Enable PMF"
			default y if WPA3
			default n if !WPA3
			help
				Enable PMF(802.11w)

		config WPA2_PREFER_TO_SAE
			depends on WPA3 && PMF
			bool "Enable WPA2 Prefer To Sae"
			default n
			help
				Prefer WPA2 instead of WPA3 if BSS in WPA3 transition mode.
				WPA2(prefer to use non-mfp) will be used instead of wpa3-sae if bss is
				in WPA3 transistion mode, and wpa3 always sets to mfp capable to avoid
				disconnection with reason code set to "Robust managment frame policy
				viloation (0x001f)" even if bss sets mfp required bit to 0 (No Required).
				This feature eliminates AP's SA query prodecure and reduces connecting time
				with AP.

		config WIFI_OWE
			depends on WPA3 || SOFTAP_WPA3
			bool "Enable WiFi OWE"
			default n

		config AP_HT_IE
			bool "Enable AP HT IE"
			default n

		config AP_VHT
			bool "Enable AP VHT"
			default n

		config AP_HE
			bool "Enable AP HE"
			default n

		config AP_VSIE
			bool "Enable AP VSIE"
			default y
			help
				Enable AP Vendor Specific IE

		config ACS_SUPPORT
			bool "Enable Auto Channel Selection"
			default n
			help
				Specify ACS scan number.

		config ACS_NUM_SCANS
			int "ACS scan number"
			range 1 10
			default 3
			depends on ACS_SUPPORT
			help
				Enable Auto Channel Selection

		config STA_VSIE
			bool "Enable STA VSIE"
			default n
			help
				Enable STA Vendor Specific IE

		config STA_AUTO_RECONNECT
			bool "Enable STA Auto Reconnect"
			default n
			help
				Enable STA auto reconnect feature.
				Supplicant automatically reconnect with AP if connection fails or disconnected
				by AP. When this function is enabled, users can set auto reconnect max retry count
				and reconnect timeout, and enable or disable auto reconnect when disconnected by AP
				if STA is in COMPLETE state.

		config WPA_LOG
			bool "Enable WPA Log"
			default n

		config WIFI_STA_MINMUM_SECURITY
			bool "Enable STA MINMUM SECURITY"
			default n

		config P2P
			bool "Enable P2P"
			default n

		config P2P_GO
			bool "Enable P2P Go"
			default n

		config WIFI_WPS
			bool "Enable WiFi WPS"
			default n

		config WPS
			bool "Enable WPS"
			default n

		config WPA2_ENTERPRISE
			bool "Enable Wpa2 Enterprise"
			default n

		config MOBILE_CONNECT_SAP_STATISTICS
			bool "Enable Mobile Connect Sap Statistics"
			default n
			help
				Statistics mobile connect sap time

		config USE_MBEDTLS
			depends on WIFI_ENABLE && (MBEDTLS || PSA_MBEDTLS) && !USE_EXTERNAL_MBEDTLS
			bool "Enable MBEDTLS"
			default y
			help
				use mbedtls as tls transport.
				Use mbedtls as the crypto suite may accelerate ECC caculation speed.

		config USE_EXTERNAL_MBEDTLS
			depends on WIFI_ENABLE
			bool "Use external mbedtls library"
			default n
			help
				Use external mbedtls library instead of armino's built-in mbedtls.
				This allows using mbedtls from external sources (source code or library).
				When enabled, you must provide the mbedtls headers via
				EXTERNAL_MBEDTLS_INCLUDE_PATH.

		config SDK_ROOT
			string "SDK root path"
			depends on USE_EXTERNAL_MBEDTLS
			default ""
			help
				Path to the SDK root directory.
				This is used to replace @CMAKE_SOURCE_DIR@ placeholder in config paths.

		config EXTERNAL_MBEDTLS_CONFIG_PATH
			string "External mbedtls config header path"
			depends on USE_EXTERNAL_MBEDTLS
			default ""
			help
				Path to the directory containing mbedtls config.h compatibility wrapper.
				This directory will be searched first for mbedtls/config.h.
				Leave empty to use the default from EXTERNAL_MBEDTLS_INCLUDE_PATH.

		config EXTERNAL_MBEDTLS_INCLUDE_PATH
			string "External mbedtls include path"
			depends on USE_EXTERNAL_MBEDTLS
			default ""
			help
				Path to the external mbedtls include directory.
				This directory should contain mbedtls header files (md.h, pk.h, etc.).

		config EXTERNAL_MBEDTLS_VERSION_3X
			bool "External mbedtls is version 3.x"
			depends on USE_EXTERNAL_MBEDTLS
			default n
			help
				Enable this if external mbedtls is version 3.x.
				This enables API compatibility adaptations:
				- mbedtls_pk_check_pair() with 4 parameters
				- mbedtls_pk_parse_key() with 7 parameters
				- MBEDTLS_ECDH_LEGACY_CONTEXT for ECDH compatibility
				- Use wpa_supplicant's aes-wrap/aes-omac1 implementations

		config EXTERNAL_MBEDTLS_ENABLE_MACROS
			string "External mbedtls enable macros"
			depends on USE_EXTERNAL_MBEDTLS
			default "MBEDTLS_SKIP_CHECK_CONFIG;ENABLE_MBEDTLS_ECP_C;ENABLE_MBEDTLS_ECDH_C;ENABLE_MBEDTLS_ECDSA_C;ENABLE_MBEDTLS_PK_C;ENABLE_MBEDTLS_ECP_DP_SECP256R1_ENABLED;ENABLE_MBEDTLS_ECP_DP_SECP384R1_ENABLED;ENABLE_MBEDTLS_ECP_DP_SECP521R1_ENABLED"
			help
				Space or semicolon separated list of macros to enable for external mbedtls.
				Common macros:
				- MBEDTLS_SKIP_CHECK_CONFIG (Skip mbedtls check_config.h validation for external config compatibility)
				- ENABLE_MBEDTLS_ECP_C (Elliptic Curve features, required for WPA3-SAE)
				- ENABLE_MBEDTLS_ECDH_C (ECDH features)
				- ENABLE_MBEDTLS_ECDSA_C (ECDSA features)
				- ENABLE_MBEDTLS_PK_C (PK parse/write functions)
				- ENABLE_MBEDTLS_ECP_DP_SECP256R1_ENABLED (SECP256R1 curve)
				- ENABLE_MBEDTLS_ECP_DP_SECP384R1_ENABLED (SECP384R1 curve)
				- ENABLE_MBEDTLS_ECP_DP_SECP521R1_ENABLED (SECP521R1 curve)

		config WPA_PSK_CACHE
			bool "Enable WPA PSK Cache"
			default y
			help
				PSK cache enable.
				Caculate psk in advance, and store it in memory. Recommended to enable if 
				no hw accelerator exists.

		config WPA_PSK_CACHE_MULTI
			bool "Enable WPA PSK Cache Multi"
			default n
			help
				caculate multiple psk

		config SELECT_NETWORK_AFTER_PSK_SET
			bool "Enable Select Network After PSK Set"
			default n
			help
				connect to AP after psk is caculated

		config MINIMIZE_SCAN_RESULT_IE
			bool "Enable Minimize Scan Result IE"
			default n
			help
				minimize scan result memory usage
	
		config SAE_OVERCLOCK
			bool "Enable SAE Overclock"
			default n
			help
				change CPU freq when do SAE process

		config WIFI_OCV
			bool "Enable WiFi OCV"
			default n

		config HOSTAPD_ACL
			bool "Enable HOSTAPD ACL"
			default n

		config MINIMUM_SCAN_RESULTS
			bool "Enable minimum scan results"
			default n

		config UAPSD
			bool "Enable UAPSD"
			default n
	endmenu

	config WIFI_FAST_CONNECT
		bool "Enable Wifi Fast Connect"
		default n
		help
			use fast connect

	config WIFI_FAST_DHCP
		depends on WIFI_FAST_CONNECT
		bool "Enable WiFi Fast DHCP"
		default n
		help
			use previous dhcp ip address

	config WIFI_WNM
		depends on WPA_SUPPLICANT
		bool "WNM"
		default n

	config WLAN_FAST_CONNECT_WITHOUT_SCAN
		bool "Enable Wlan Fast Connect Without Scan"
		default n
		help
			fast connect with scan.
			wpa_supplicant will use beacon/probersp IEs from fci, and connect with
			AP without any scan.

	config WLAN_FAST_CONNECT_DEAUTH_FIRST
		bool "Enable Wlan Fast Connect Default First"
		default n
		help
			send deauth to AP before connect with AP.
			Recommend to enable if AP enables MFP. deauth frame is sent in encryted or
			unencrypt format to AP according to pmf value from fci.

	config WLAN_FAST_CONNECT_WPA3
		bool "Enable Wlan Fast Connect WPA3"
		default n
		help
			WPA3 fast connect support.
			After STA has connected with AP, fci will stores additional pmk, pmkid, and
			after reboot, supplicant will use open auth algo instread of sae. Recommends
			to enable WLAN_FAST_CONNECT_DEAUTH_FIRST.

	config FAST_CONNECT_INFO_ENC_METHOD
		int "Enable Fast Connect Info Enc Method"
		default 1
		help
			fci encryption method.
			1 for NULL, 2 for XOR, 3 for AES.

	config WPA_AUTH_TIMEOUT
		int "Enable WPA Auth Timeout"
		default 1 if MIDEA
		default 2 if !MIDEA
		help
			auth timeout for wpa/802.1x authentication

	config WIFI_ROAMING
		bool "Enable 802.11R Roaming"
		default n

	config BK_SUPPLICANT_OPTIMIZE_CONNECTION
		bool "Enable BK Connection Optimize"
		default n
	
	config AP_STATYPE_LIMIT
		bool "Enable Ap mode Sta Type Limit num"
		default n

endmenu
```

## components/wpa_supplicant/Kconfig
```kconfig
menu "Wpa_supplicant"
	config WPA_SUPPLICANT
		depends on WIFI_ENABLE
		bool "Enable WPA_SUPPLICANT"
		default y
	config CRYPTO
		depends on WIFI_ENABLE
		bool "Enable CRYPTO"
		default y
	config WPA3
		depends on WIFI_ENABLE
		bool "Enable WPA3"
		default y
		help
			When WPA3 is enabled, the PMF should be enabled also!
	config USE_MBEDTLS
		depends on WIFI_ENABLE && MBEDTLS
		bool "Enable MBEDTLS"
		default y
	config WPA_PSK_CACHE
		bool "Enable WPA PSK CACHE"
		default y

	config WPA_LOG
		bool "Enable WPA Log"
		default n

	config P2P
		bool "Enable P2P"
		default n

	config P2P_GO
		bool "Enable P2P Go"
		default n

	config WIFI_WPS
		bool "Enable WiFi WPS"
		default n

	config WPS
		bool "Enable WPS"
		default n

	config WPA2_ENTERPRISE
		bool "Enable Wpa2 Enterprise"
		default n

	config WIFI_OWE
		depends on WPA3 || SOFTAP_WPA3
		bool "Enable WiFi OWE"
		default n

	config PMF
		bool "Enable PMF"
		default y if WPA3
		default n if !WPA3
		help
			Enable PMF(802.11w)
endmenu
```

## middleware/driver/h264/Kconfig
```kconfig
menu "H264_CONFIG"
	config H264
		bool "Enable h264"
		default n

	config H264_QUALITY_LEVEL
		int "set h264 compress quality level"
		range 0 3
		default 2

	config H264_GOP_START_IDR_FRAME
		bool "Enable add pps and sps before i frame"
		default y

	config H264_ADD_SELF_DEFINE_SEI
		bool "Enable function add sei nalu for self define, contain frame information"
		default n
endmenu
```

## middleware/driver/otp/Kconfig
```kconfig
menu "OTP"
	config OTP
		bool "Enable OTP"
		default n

	config OTP_PUF
		bool "Enable OTP random for bk_rand"
		default n
		depends on OTP
		help
			Use OTP PUF to generate true random numbers.

	config FLASH_OTP
		bool "Enable FLASH_OTP"
		default n

	config PHY_RFCALI_TO_OTP
		bool "Enable rfcali_to_otp"
		default n
		help
			Use OTP to save rfcali data

	config AON_ENCP
		bool "Always enable encp"
		default n
	
	config OTP_EFUSE_SUPPORT
		bool "Enable otp to efuse"
		default n

endmenu
```

## middleware/driver/qspi/Kconfig
```kconfig
menu "QSPI"
		config QSPI
			bool "Enable QSPI"
			default n

		config QSPI_STATIS
			bool "Enable QSPI Statis"
			default n

		config QSPI_FLASH
			bool "Enable QSPI Flash"
			depends on QSPI
			default n

		config QSPI_FLASH_GD
			bool "Enable GD Flash"
			default n
endmenu
```

## middleware/driver/reset_reason/Kconfig
```kconfig
menu "RESET_REASON"
	config RESET_REASON
		bool "Enable reset reason"
		default y
	config DISPLAY_START_TYPE_STR
		bool "Enable display string of reset reason"
		default y
endmenu
```
