## components/bk_wifi/Kconfig
```kconfig
#TODO optimize it
menu "Bk_Wifi"

	config WIFI_ENABLE
		bool "Enable Wifi Enable"
		default y
		help
			enable wifi

	config WIFI_TX_RAW_ENABLE
		bool "Enable Wifi TX RAW Enable"
		default y
		help
			enable wifi TX RAW

	config WIFI6_CODE_STACK
		depends on WIFI_ENABLE
		bool "Enable Wifi6 Code Stack"
		default y
		help
			Use WiFi-6 Code Stack

	config WAPI_SUPPORT
		bool "Support WAPI nAPI"
		default n

	config USER_SPECIFIC_SCAN
		bool "Support user specific scan"
		default n

	config CCA_AND_RTS_CTS
		bool "config CCA and RTS/TCS"
		default n

	config AP_FAST_START_UP
		bool "Enable AP_FAST_START_UP"
		default n

	config WIFI_BAND_5G
		depends on WIFI_ENABLE
		bool "Enable 5G Band"
		default n
		help
			Enable WiFi 5G Band.

	config WIFI_BAND_6G
		depends on WIFI_ENABLE
		bool "Enable 6G Band"
		default n
		help
			Enable WiFi 6G Band.

	config WIFI4
		depends on WIFI_ENABLE
		bool "Enable Wifi4"
		default y
		help
			Don't disable it when WiFi-6 is enabled.

	config WIFI5
		bool "Enable Wifi5"
		depends on WIFI6_CODE_STACK && WIFI_BAND_5G
		default n
		help
			Don't disable it when WiFi-6 is enabled.

	config WIFI6
		bool "Enable Wifi6"
		depends on WIFI6_CODE_STACK && WIFI_ENABLE
		default n

	config WIFI6E
		bool "Enable Wifi6e"
		depends on WIFI6_CODE_STACK && WIFI_BAND_6G
		default n
		help
			Don't disable it when WiFi-6 is enabled.

	config WIFI6_IP_DEBUG
		depends on WIFI6_CODE_STACK
		bool "Enable Wifi6 Ip Debug"
		default n

	config MULTI_STA_IN_SAP
		depends on WIFI_ENABLE
		bool "Enable Multi STA"
		default n

	config WIFI_PS_DISABLE
		bool "Disable WiFi PS"
		default n
		help
			disable wifi ps if need.

	config WIFI_SLEEP_MODE_SUPPORT
		bool "support config sleep mode"
		default n

	config WIFI_MONITOR
		bool "support monitor mode"
		default y

	config WIFI_NON_STANDARD
		bool "Enable WiFi Non Standard"
		default n

	config WIFI_CSI_EN
		depends on WIFI_ENABLE
		bool "Wifi CSI"
		default n
		
	config WIFI_CSI_DEMO
		depends on WIFI_CSI_EN
		bool "Wifi CSI Demo"
		default n
		
	config WIFI_CSI_MEMORY_OPTIMIZATION
		depends on WIFI_CSI_EN
		bool "Wifi CSI MEMORY_OPTIMIZATION"
		default n

	config WIFI_WIRELESS_MODE_SUPPORT
		bool "support configure wireless mode"
		default n

	config WIFI_RETRY_CONFIG_SUPPORT
		bool "support retry config"
		default n

	config WIFI_AUTO_COUNTRY_CODE
		bool "Wifi AUTO CC"
		default n

	config WIFI_SCAN_COUNTRY_CODE
		bool "Wifi SCAN CC"
		default n

	config MSDU_RESV_HEAD_LENGTH
		int "Set Msdu Resv Head Length"
		range 1 1500
		default 96
		help
			MSDU reserved header length

	config MSDU_RESV_TAIL_LENGTH
		int "Set Msdu Resv Tail Length"
		range 1 1500
		default 16
		help
			MSDU reserved tail length
	
	config TASK_RECONNECT_PRIO
		int "Set Task Reconnect Prio"
		range 1 10
		default 4
		help
			Priority of WiFi reconnect task

	config AP_MONITOR_COEXIST
		bool "Enable Ap Monitor Coexist"
		default n
		help
			enable AP and monitor coexist

	config CONNECT_THROUGH_PSK_OR_SAE_PASSWORD
		bool"Enable connect through psk or sae password"
		default n

	config WIFI_FAST_CONNECT
		bool "Enable Wifi Fast Connect"
		default n

	config EASY_FLASH_FAST_CONNECT
		depends on EASY_FLASH_V4 && (WIFI_FAST_CONNECT || CONNECT_WITH_MFP_DEAUTH)
		bool "Enable Wifi Fast Connect with easy flash"
		default y

	config AP_PS
		bool "Enable AP PS"
		default n

	config AP_TX_TIM
		bool "Enable ap tx tim in connection"
		default n

	config UAPSD
		bool "Enable UAPSD"
		default n
		help
		Enable use uapsd

	config BSSID_CONNECT
		depends on WIFI_ENABLE
		bool "Enable Bssid Connect"
		default n
		help
			enable WiFi BSSI connect

	config WFA_CERT
		bool "Enable Wfa Cert"
		default n
		help
			enable WiFi WFA Certification

	config LESS_MEMERY_IN_RWNX
		bool "Enable Less Memory In Rwnx"
		default n

	config STA_PS
		bool "Enable Sta Ps"
		default y if !RF_OTA_TEST
		default n if RF_OTA_TEST

	config MAC_BSSID
		depends on WIFI_ENABLE
		bool "Enable Mac Bssid"
		default n

	config COMPONENTS_STA_VSIE
		depends on WIFI_ENABLE
		bool "Enable Components Sta Vsie"
		default n

	config AP_STATYPE_LIMIT
		depends on WIFI_ENABLE && COMPONENTS_STA_VSIE
		bool "Enable Ap mode Sta Type Limit"
		default n
	
	config RECEIVE_BCMC_IN_DTIM10
		bool "Enable Station to Receive BCMC frame in Dtim10"
		default n

	config NOT_CHECK_SSID_CHANGE
		bool "Enable not check beacon ssid changes"
		default n

	config NET_PARAM
		bool "Enable Net Param"
		default y

	config DEAUTH_BEFORE_CONNECT
		bool "send deauth before connect"
		default n

	config IMPROVE_HE_TB_ENABLE
		bool "improve he tb enable"
		default n

	config CLOSE_COEXIST_CSA
		bool "Close coexist csa"
		default n

	config SCAN_SPEED_LEVEL
		int "set scan speed level"
		range 1 3
		default 3

	config NETWORK_FOUND_EVENT_ENABLE
		bool "Enable network found event"
		default n

	config DTIM_EVENT_ENABLE
		bool "Enable dtim event and wake event"
		default n

	config POWER_TABLE
		bool "Enable POWER TABLE"
		default n

	config PM_V2
        	bool "Enable PM V2"
        	default y
        	help
            		Enable power manager V2

	config WIFI_KMSG_TASK_PRIO
		int "Set WiFi Kmsg Task Prio"
		range 1 10
		default 3
		help
			Priority of WiFi kernel message task

	config WIFI_KMSG_TASK_STACK_SIZE
		int "Set Wifi Kmsg Task Stack Size"
		default 4096
		help
			Stack size of WiFi kernel message task

	config WIFI_CORE_TASK_PRIO
		int "Set Wifi Core Task Prio"
		range 1 10
		default 2
		help
			Priority of WiFi core task

	config WIFI_CORE_TASK_STACK_SIZE
		int "Set Wifi Core Task Stack Size"
		default 2048
		help
			Stack size of WiFi core task

	config RWNX_QOS_MSDU
		bool "Enable RWNX Qos MSDU"
		default y
		help
			Enable QoS MSDU

	config WPA_TWT_TEST
		bool "Enable Wpa Twt Test"
		default n
		help
			TWT TEST

	config RWNX_PROTO_DEBUG
		bool "Enabel RWNX Proto Debug"
		default n

	config RWNX_SW_TXQ
		depends on WIFI6_CODE_STACK
		bool "Enable RWNX SW TXQ"
		default y
		help
			Enable Software Transmit Queue, recommend to enable this feature

	config RWNX_TD
		bool "Enable RWNX TD"
		default y

	config RWNX_MULTIPLE_SSID_STA_MODE
		depends on WIFI6_CODE_STACK
		bool "Enable RWNX MULTIPLE SSID STA MODE"
		default n

	config MINIMUM_SCAN_RESULTS
		depends on WIFI6_CODE_STACK
		bool "Enable minimum scan results"
		default n

	config BSS_MAX_COUNT
		int "Set BSS Max Count"
		range 24 96
		default 64
		help
			maximum number of BSS entries to keep in the cache

	config BSS_EXPIRATION_AGE
		int "Set BSS Expiration Age"
		range 5 100
		default 10
		help
			expiration age of BSS entries in the cache

	config BK_MEM_DYNA_APPLY_EN
		bool "Enable BK Mem Dyna Apply En"
		default y
		help
			mem dyna app enable

	# bk_hostapd
	config BK_HOSTAPD
		depends on WIFI_ENABLE
		bool "Enable Bk Hostapd"
		default y
		help
			Enable bk hostapd

	config RWNX_FAST_CONNECT
		depends on WIFI6_CODE_STACK
		bool "Enable WiFi Fast Connect"
		default n
		help
			Skip WiFi Join Network procedure to reduct network connection time
			when supplicant passes beacon ies to Umac.

	config P2P
		bool "Enable P2P"
		default n

	config P2P_GO
		bool "Enable P2P Go"
		default n

	config TX_BUFING
		bool "Enable Tx Bufing"
		default n
		help
			Enable wifi tx bufing

	config AP_PS
		bool "Enable AP PS"
		default n
		help
			enable use ap ps

	config USE_P2P_PS
		bool "Enable Use P2P PS"
		default n

	config AP_PROBEREQ_CB
		bool "Enable AP Probereq Cb"
		default n
		help
			Enable AP probe request callback

	config SPECIAL_TX_TYPE
		depends on WIFI6_CODE_STACK
		bool "Enable Special Tx Type"
		default y
		help
			Enable snd special tx frame

	config MAC_SFRAME_SOFTWARE_RETRY
		bool "Enable Mac Sframe Software Retry"
		default y
		help
			software retry

	config WIFI_FTM
		bool "Enable wifi FTM feature"
		default n

	config WIFI_MAC_SUPPORT_STAS_MAX_NUM
		int "Set Wifi MAC Support STAs Max Num"
		range 2 10
		default 2

	config BK_WIFI_MESH
		bool "Enable BK wifi mesh feature"
		default n
		select WIFI_SOFTAP

	config TCP_PROTECT_EN
		bool "Enable tcp protect in connected"
		default n

	config MAC_SHORT_RETRY
		int "MAC short retry limit"
		range 1 240
		default 240

	config MAC_LONG_RETRY
		int "MAC long retry limit"
		range 1 240
		default 240

	config DEFAULT_TX_TID
		int "default wifi tx tid"
		range 0 7
		default 0

	config DEFAULT_SPECIAL_TX_TID
		int "default wifi tx tid for special tx frames"
		range 0 7
		default 0

	config DEFAULT_TD_WIN
		int "Set default td window"
		range 30 100
		default 60

	config TD_REDUCE_INTV
		int "Set reduce td window"
		range 5 20
		default 20

	config DYNAMIC_TD_LEARN
		int "Set td learn cnt"
		range 3 10
		default 5

	config DYNAMIC_TD_RUN
		int "Set td run cnt"
		range 10 100
		default 20

	config DYNAMIC_TD_LEVEL2
		int "Set td level2 threshold"
		range 1 5
		default 2

	config ARP_FAIL_TRIG_NULL
		bool "Enable null if arp failed"
		default y

	config AP_DRIFT_STATISTIC_CNT
		int "Set ap drift statistic cnt"
		range 1 5
		default 3

	config KEEP_ALIVE_RETRY_CNT
		int "Set keep alive retry cnt"
		range 0 5
		default 3

	config LISTEN_INTERVAL_THRESHOLD
		int "Set listen interval threshold for arp keepalive"
		default 307200

	config VIF_MGMT_KEEP_ALIVE_TO_DUR
		int "Set keep alive timeout duration"
		range 1000 50000
		default 10000

	config COMPUTE_LISTEN_INTERVAL
		bool "Enable compute listen interval"
		default n

	config CORRECT_LISTEN_INTERVAL_IE
		bool "put correct listen interval ie in assoc req"
		default n

	config BEACON_MISS_CB
		bool "Enable beacon miss callback function"
		default n

	config WIFI_NULL_FRAME_WITH_SN
		bool "Wifi [QoS] Null frames with sequence number"
		default y

	config DEFAULT_COUNTRY_CODE
		string "Default country code"
		default "00"
		help
			Specifiy default country code, "00" is world regulatory domain.

	config WIFI_REGDOMAIN
		bool "Enable Wifi regulatory domain (802.11d)"
		default n
		help
			Enable regulatory domain.

	config WIFI_REGDOMAIN_WMM
		bool "Enable 802.11d WMM rules"
		depends on WIFI_REGDOMAIN
		default n
		help
			Enable 802.11d wmm rules.

	config WIFI_REGDOMAIN_FWDB
		bool "Enable 802.11d WMM rules"
		depends on WIFI_REGDOMAIN
		default y
		help
			Enable binary regulatory db instead of human readable rules.
			Enable this feature to save flash usage.

	config WIFI_RADAR_SUPPORT
		bool "Enable radar support"
		default n
		help
			Enable regulatory radar support.

	config WIFI_REGDOMAIN_UPDATE_BY_SCAN
		bool "regdomain updated by scan"
		depends on WIFI_REGDOMAIN
		default n
		help
			Use scan results to update regulatory domain.

	config WIFI_SAP_PROBE_RSP_LIFETIME
		int "softap probe response life time"
		default 0
		help
			Set softap probe response lifetime(in us), 0 to disable.

	config MEM_SHORTAGE_LOG_ENABLE
		bool "Enable memory shortage log enable"
		default n
		help
		    Enable memory shortage log.

	config ADD_CHAN_CTXT
		bool "add chan ctxt"
		default n

	config CUSTOMER_INIT_CALI
		bool "Enable customer init calibration"
		default n

	config PM_DSSS_ONLY
		bool "Enable DSSS ONLY"
		default n
		help
			Enable DSSS ONLY

	config WIFI_COEX_DUR
		int "RF hold time when coex with BT"
		range 20 80
		default 35

	config ENCRYPT_WIFI_INFO
		bool "Enable encrypt wifi infomation"
		default n
		help
			Enable encrypt wifi info

	config UPDATE_POWER_WITH_RSSI
		bool "Enable update power with RSSI"
		default y
		help
			Enable update power with RSSI

	config MICROWAVE_POLICY
		depends on WIFI_ENABLE
		bool "Enable Microwave Policy"
		default n

endmenu
```

## components/nvs/Kconfig
```kconfig
menu "NVS"
    config SUPPORT_NVS_FLASH
        bool "Enable NVS FLASH"
        default n

    config NVS_ENCRYPTION
        bool "Enable NVS encryption"
        depends on SUPPORT_NVS_FLASH
        default n
        help
            This option enables encryption for NVS. When enabled, XTS-AES is used to encrypt
            the complete NVS data, except the page headers. It requires XTS encryption keys
            to be stored in an encrypted partition (enabling flash encryption is mandatory here)
            or to be derived from an HMAC key burnt in eFuse.

    config SHANHAI_KEY_LADDER
        depends on SUPPORT_NVS_FLASH
        bool "Enable shanghai/te200 Key Ladder"
        default n

    config NVS_TEST
        bool "Enable nvs test"
        depends on SUPPORT_NVS_FLASH
        default n

    config SUPPORT_NVS_THREAD_SAFETY_TEST
        bool "Enable nvs thread safety test"
        depends on SUPPORT_NVS_FLASH && NVS_TEST
        default n

    config NVS_DEBUG_STORAGE
        bool "Enable nvs debug storage"
        default n
endmenu
```

## components/paho-mqtt/Kconfig
```kconfig
menu "Paho_mqtt"

	config PAHO_MQTT
		depends on WIFI_ENABLE
		bool "Enable Paho MQTT Client"
		default n
		help
			Enable Eclipse Paho MQTT client library for IoT communication

	config PAHO_MQTT_TLS
		depends on PAHO_MQTT && PSA_MBEDTLS
		bool "Enable Paho MQTT TLS Support"
		default n
		help
			Enable TLS/SSL encryption support for Paho MQTT client

	config PAHO_MQTT_TEST
		depends on PAHO_MQTT
		bool "Enable Paho MQTT Test Code"
		default n
		help
			Include test code for Paho MQTT client (for development only)

endmenu
```

## components/part_table/Kconfig
```kconfig
menu "Part_table"
	config FLASH_PARTITION_USER
		bool "Enable flash partition user"
		default y
endmenu
```
