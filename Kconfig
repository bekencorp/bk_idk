## components/at_server/Kconfig
```kconfig
menu "At_server"

config AT
	bool "Enable At"
	default y
		
	config WIFI_AT_ENABLE
		depends on AT 
		bool "Enable WIFI AT CMDS"
		default y

	config MISC_AT_ENABLE
		depends on AT 
		bool "Enable SYSTEM AT CMDS"
		default y

	config BT_AT_ENABLE
		depends on AT 
		bool "Enable BLUETOOTH AT CMDS"
		default y

	config BLE_AT_ENABLE
		depends on AT 
		bool "Enable BLE AT CMDS"
		default y

	config NETIF_AT_ENABLE
		depends on AT 
		bool "Enable netif AT CMDS"
		default y
		
	config PHY_AT_ENABLE
		depends on AT 
		bool "Enable phy AT CMDS"
		default y
		
	config PM_AT_ENABLE
		depends on AT 
		bool "Enable pm AT CMDS"
		default y
		
	config HTTPS_CLIENT_AT_ENABLE
		depends on AT 
		bool "Enable HTTP AT CMDS"
		default y

	config WEBSOCKET_CLIENT_AT_ENABLE
		depends on AT 
		bool "Enable WEBSOCKET AT CMDS"
		default y
	config DEFAULT_AT_PORT
		depends on AT 
		int "defualt at_Port"
		default 1
		
	config AT_MAX_PORT_CNT
		depends on AT 
		int "defualt AT_CLIENT nums"
		default 1		
		
		
endmenu
 
```

## components/bk_bluetooth/Kconfig
```kconfig
menu "Bk_ble"
	depends on BLUETOOTH

	config BT
		bool "Enable Bt"
		default n

	config BLE
		bool "Enable Ble"
		default y

	choice BLE_STACK
		prompt "Select Ble Version"
		depends on (BLE || BT)
		default BLE_5_X

		config BLE_5_X
			bool "BLE 5.X"
		config BLE_4_2
			bool "BLE 4.2"
		config BTDM_5_2
			bool "BTDM 5.2"
		config BTDM_5_2_MINDTREE
			bool "BTDM 5.2 Mindtree Host"
	endchoice

	config BTDM_CONTROLLER_ONLY
		bool "BTDM controller only"
		default n

	config BLUETOOTH_RELEASE_CODESIZE
		bool "reduce ble stack size"
		depends on BLE
		default n
		help
			This option is used to reduce ble stack size for IoT scenarios that
			only use ble provisioning network.It supports two ble advertise,
			one ble link, and ble scan at the same time.it does not support SMP and central role.
			when config this option,BLUETOOTH_BLE_SLAVE_ONLY will be invalid.

	config BLUETOOTH_BLE_SLAVE_ONLY
		bool "only supports ble slave"
		depends on !BLUETOOTH_RELEASE_CODESIZE
		default n

	config BLUETOOTH_BLE_DISCOVER_AUTO
		bool "auto ble discover. Only used when single ble host"
		default y
	config BLUETOOTH_SUPPORT_LPO_ROSC
		bool "support lpo rosc"
		default n
	config BLUETOOTH_SUPPORT_IRAM_CODE
		bool "support iram code"
		default n
	config BLUETOOTH_USE_MIN_POWER_MODE
		bool "use minimum power mode"
		default n
	config BLUETOOTH_SUPPORT_COEX_RF_MODE_SWITCH
		bool "support coex rf mode switch"
		default n
	config BLUETOOTH_SLEEP_PHY_SWITCH
		bool "support sleep phy switch"
		default n
	config BLE_LV_SUPPORT
		bool "support low voltage sleep"
		default n

	config CUSTOMER_INIT_BLE
		bool "Enable customer init BLE"
		default n
	config BLE_THREAD_COEXIST_EN
		bool "bt and thread coexist enable"
		default n

	config BLUETOOTH_NSP24G
		bool "Enable nsp24g feature"
		depends on BLE
		default n

	config COEX
		bool "Enable software coexistence"
		depends on BLE
		default n

	config SUPPORT_GENERIC_SVC
		bool "Support generic service 1800 and 1801"
		depends on BLE
		default y
endmenu
```

## components/bk_https/Kconfig
```kconfig
menu "Https"
	config HTTPS
		depends on LWIP
		bool "Enable HTTPS"
		default n
endmenu
```

## components/bk_log/Kconfig
```kconfig
menu "BK_LOG"
	config LOG_LEVEL
		int "Set log level: 0-None, 1-Error, 2-WARN, 3-INFO, 4-DEBUG"
		default 3
endmenu
```

## components/bk_mcuboot/Kconfig
```kconfig
menu "BL2"
	config BL2
		bool "Enable BL2(MCUBOOT)"
		default n

	config MIXED_OTA
		bool "both overwrite and xip"
		default n

	menu "Modify BL2 Info"
		depends on BL2

		config BL2_BUILD_TYPE
			string "Define BL2 Build Type"
			default "minsizerel"
			help
				build type: debug, release or minsizerel

		config BL2_LOG_LEVEL
			string "Define Bl2 Log Level"
			default "INFO"
			help
				Set BL2 log level: OFF/ERROR/WARNING/INFO/DEBUG

		config BL2_DOWNLOAD
			bool "Enable BL2 download"
			default n
			help
				Enable BL2 Download

		config SECURE_DEBUG
			bool "Enable Secure Debug"
			default n
			help
				Enable Secure Debug

		config BL2_UPGRADE_STRATEGY
			string "Define mcuboot upgrade strategy"
			default "OVERWRITE_ONLY"
			help
				The MCUBOOT upgrade strategy can be:
				OVERWRITE_ONLY, DIRECT_XIP.

		config ANTI_ROLLBACK
			bool "Enable OTA anti-rollback"
			default n

		config BL2_SKIP_VALIDATE
			bool "Bl2 skip validate"
			default n

		config BL2_VALIDATE_ENABLED_BY_EFUSE
			bool "BL2 validate is enabled by eFuse"
			default n

		config BL2_WDT
			bool "Enable BL2 watchdog"
			default y

		config BL2_DOWNLOAD
			bool "Enable BL2 download"
			default n

		config BL2_WDT_PERIOD
			hex "BL2 wdt timeout period"
			default 0x1F40

		config BL2_UPDATE_WITH_PC
			bool "update BL2 with pc"
			default n
			help
				update BL2 with pc

		config RANDOM_AES_UPGRADE_BL2
			bool "upgrade bl2 for random aes key"
			default n
			help
				upgrade bl2 for random aes key

		config OTA_CONFIRM_UPDATE
			bool "confirm update after ota download"
			default y
			
		config DBUS_CHECK_CRC
			bool "do crc check before cbus read"
			default y

		config XIP_NO_VERSION
			bool "xip without security counter and version"
			default n

		config DECOMPRESS_RESUME
			bool "decompress resume"
			default y

		config BL2_UPGRADE_WITH_APP
		bool "Enable BL2 upgrade with application"
		default n
	endmenu
endmenu
```

## components/bk_persist_config/Kconfig
```kconfig
menu "PERSIST_CONFIG"

	config PERSIST_CONFIG
		bool "Enable system persist config cli"
		default n

	config PERSIST_CONFIG_CLI
		depends on PERSIST_CONFIG
		bool "Enable system persist config cli"
		default y
endmenu
```
