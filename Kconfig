## middleware/driver/spi/Kconfig
```kconfig
menu "SPI"
	#TODO optimize SPI_DMA and GENERAL_DMA when optimize driver
	config SPI_DMA
		bool "Enable SPI DMA"
		default y

	config SPI_STATIS
		bool "Enable SPI Statis"
		default n

	config SPI_SUPPORT_TX_FIFO_WR_READY
		bool "Support TX FIFO Write Ready"
		default y

	config SPI_MST_FLASH
		bool "SPI MST Flash"
		default n

	config SUPPORT_SPI_ISR_HIGH_PRIORITY
		bool "SPI ISR High Prioriy"
		default n

	config SUPPORT_XMIT_READY_CALLBACK
		bool "SPI tx/rx ready callback"
		default n

	config SPI_MST_PSRAM
		bool "SPI MST PSRAM"
		default n

	config SPI_PM_CB_SUPPORT
		bool "SPI PM Support"
		default n
	config SPI
		bool "SPI ENABLE"
		default y

	config SPI_BYTE_INTERVAL
		bool "SPI byte interval"
		default n

endmenu
```

## middleware/soc/Kconfig
```kconfig
menu "SOC_CONFIG"

	choice SOC
		prompt "ARMINO SoC"
		default SOC_BK7236 if "$ARMINO_SOC" = "bk7236"
		default SOC_BK7236_CP1 if "$ARMINO_SOC" = "bk7236_cp1"
		default SOC_BK7236N if "$ARMINO_SOC" = "bk7236n"
		default SOC_BK723L if "$ARMINO_SOC" = "bk723L"
		default SOC_BK7234 if "$ARMINO_SOC" = "bk7234"
		default SOC_BK7239N if "$ARMINO_SOC" = "bk7239n"
		default SOC_BK7258 if "$ARMINO_SOC" = "bk7258"
		default SOC_BK7258_CP1 if "$ARMINO_SOC" = "bk7258_cp1"
		default SOC_BK7258_CP2 if "$ARMINO_SOC" = "bk7258_cp2"

		config SOC_BK7236
			select SOC_BK7236XX
			bool "BK7236"
		config SOC_BK7234
			select SOC_BK7236XX
			bool "BK7234"
		config SOC_BK7236_CP1
			select SOC_BK7236XX
			bool "BK7236_CP1"
		config SOC_BK7236N
			select SOC_BK7236XX
			bool "BK7236N"
		config SOC_BK723L
			bool "BK723L"
		config SOC_BK7239N
			bool "BK7239N"
		config SOC_BK7258
			select SOC_BK7236XX
			bool "BK7258"
		config SOC_BK7258_CP1
			select SOC_BK7236XX
			bool "BK7258_CP1"
		config SOC_BK7258_CP2
			select SOC_BK7236XX
			bool "BK7258_CP2"
	endchoice

	choice System
		prompt "System"
		default SYS_CPU1 if "$ARMINO_SOC" = "bk7234_cp1"
		default SYS_CPU1 if "$ARMINO_SOC" = "bk7235_cp1"
		default SYS_CPU1 if "$ARMINO_SOC" = "bk7236_cp1"
		default SYS_CPU1 if "$ARMINO_SOC" = "bk723L_cp1"
		default SYS_CPU1 if "$ARMINO_SOC" = "bk7239n_cp1"
		default SYS_CPU1 if "$ARMINO_SOC" = "bk7286_cp1"
		default SYS_CPU1 if "$ARMINO_SOC" = "bk7258_cp1"
		default SYS_CPU2 if "$ARMINO_SOC" = "bk7258_cp2"
		default SYS_CPU0

		config SYS_CPU0
			bool "CPU0 system"

		config SYS_CPU1
			bool "CPU1 system"

		config SYS_CPU2
			bool "CPU2 system"
	endchoice

	config CPU_CNT
			int "System CPU count: 1: single core, 2: dual core, etc."
			default 1

	config SOC_STR
		string "SoC string"
		default "bk7236"  if SOC_BK7236
		default "bk7236_cp1"  if SOC_BK7236_CP1
		default "bk7236n" if SOC_BK7236N
		default "bk723L"  if SOC_BK723L
		default "bk7234"  if SOC_BK7234
		default "bk7239n"  if SOC_BK7239N
		default "bk7258"  if SOC_BK7258
		default "bk7258_cp1"  if SOC_BK7258_CP1
		default "bk7258_cp2"  if SOC_BK7258_CP2
		default "$ARMINO_SOC"

	config SOC_ARCH
		string "Soc arch"
		default "unknown"

	config SOC_BK7236XX
		bool "For bk7236 series chipset"
		default n

	config SOC_SMP
		bool "For soc smp feature"
		default n

	config SOC_BK7236_SMP
		bool "For bk7236 smp"
		default n

	config SOC_BK7236_SMP_TEMP
		bool "For bk7236 smp temp"
		default n

	config SOC_BK7239XX
		bool "For bk7239n series chipset"
		default n

	config PRODUCT_STRING
		string "Product string"
		default ""
endmenu
```

## projects/customization/ty/main/Kconfig.projbuild
```kconfig
menu "Project specific config"
	config CUSTOMIZE_TY
		bool "Enable customize tuya"
		default n
endmenu
```
